## arch/lkl/Kconfig
```kconfig
config LKL
       def_bool y
       depends on !SMP && !MMU && !COREDUMP && !SECCOMP && !UPROBES && !COMPAT && !USER_RETURN_NOTIFIER
       select ARCH_THREAD_STACK_ALLOCATOR
       select RWSEM_GENERIC_SPINLOCK
       select GENERIC_ATOMIC64
       select GENERIC_HWEIGHT
       select FLATMEM
       select FLAT_NODE_MEM_MAP
       select GENERIC_CLOCKEVENTS
       select GENERIC_CPU_DEVICES
       select NO_HZ_IDLE
       select NO_PREEMPT
       select ARCH_WANT_FRAME_POINTERS
       select HAS_DMA
       select PHYS_ADDR_T_64BIT if 64BIT
       select 64BIT if OUTPUT_FORMAT = "elf64-x86-64"
	   select 64BIT if OUTPUT_FORMAT = "pe-x86-64"
       select HAVE_UNDERSCORE_SYMBOL_PREFIX if OUTPUT_FORMAT = "pe-i386"
       select 64BIT if OUTPUT_FORMAT = "elf64-x86-64-freebsd"
       select IP_PNP
       select IP_PNP_DHCP
       select TCP_CONG_BBR
       select HIGH_RES_TIMERS
       select NET_SCHED
       select NET_SCH_FQ
       select NETFILTER
       select IP_NF_IPTABLES
       select IP_NF_FILTER
       select NF_TABLES
       select NF_CONNTRACK
       select NF_NAT
       select NF_NAT_NEEDED
       select NF_NAT_PROTO_DCCP
       select NF_NAT_PROTO_UDPLITE
       select NF_NAT_PROTO_SCTP
       select NF_NAT_REDIRECT
       select NF_TABLES
       select NF_DEFRAG_IPV4
       select NF_CONNTRACK_IPV4
       select NFT_NFT_NAT
       select NETFILTER_XTABLES
       select NF_NAT_IPV4
       select NF_NAT_MASQUERADE_IPV4
       select IP_NF_NAT
       select IP_NF_TARGET_MASQUERADE
       select NETFILTER_XT_NAT



config OUTPUTFORMAT
       string
       option env="OUTPUT_FORMAT"

config OUTPUT_FORMAT
       string "Output format"
       default OUTPUTFORMAT

config ARCH_DMA_ADDR_T_64BIT
       def_bool 64BIT

config 64BIT
       def_bool n

config BIG_ENDIAN
       def_bool n

config GENERIC_CSUM
       def_bool y

config GENERIC_HWEIGHT
       def_bool y

config NO_IOPORT_MAP
       def_bool y

config RWSEM_GENERIC_SPINLOCK
	bool
	default y

source init/Kconfig

source net/Kconfig

source drivers/Kconfig

source fs/Kconfig

source mm/Kconfig

source kernel/Kconfig.preempt

source kernel/Kconfig.locks

source kernel/Kconfig.hz

source security/Kconfig

source crypto/Kconfig

source lib/Kconfig

source lib/Kconfig.debug
```
